## src/Kconfig.projbuild
```kconfig
menu "Civic Oil Gauge"

    config OIL_GAUGE_DEMO_MODE
        bool "Use synthetic demo readings"
        default y
        help
            Keep this enabled until the installed Innovate pressure and
            temperature sensors have measured, cross-validated calibrations.

    config OIL_GAUGE_ADS1115_DIAGNOSTICS
        bool "Probe ADS1115 and log raw floating inputs"
        default y
        help
            Bench-only diagnostics at I2C address 0x48. Logs raw A0-A3 counts
            and ADC pin voltages without enabling sensor conversions.

    config OIL_GAUGE_BRIGHTNESS_PERCENT
        int "AMOLED brightness (%)"
        range 5 100
        default 55
        help
            Initial AMOLED brightness used for the bench graphics demo.

    config OIL_GAUGE_DEMO_WARNING_AUDIO
        bool "Play warning sound during the synthetic demo"
        depends on OIL_GAUGE_DEMO_MODE
        default y
        help
            Use the onboard ES8311 codec and integrated speaker to play one
            non-blocking double beep when the demo enters pressure warning.

    config OIL_GAUGE_WARNING_AUDIO_VOLUME_PERCENT
        int "Warning speaker volume (%)"
        range 5 100
        default 35
        help
            Codec output volume for the synthetic warning double beep.

endmenu
```
